## boards/nicekeyboards/nice_nano/Kconfig.defconfig
```kconfig
# SPDX-License-Identifier: Apache-2.0

if BOARD_NICE_NANO

config ARM_MPU
	default y

config PINCTRL
	default y

config GPIO
	default y

config USE_DT_CODE_PARTITION
	default y

config FLASH
	default y

config FLASH_PAGE_LAYOUT
	default y

config FLASH_MAP
	default y

endif
```

## boards/nicekeyboards/nice_nano/board.yml
```yaml
board:
  name: nice_nano
  full_name: nice!nano
  vendor: nicekeyboards
  socs:
    - name: nrf52840
```

## boards/nicekeyboards/nice_nano/nice_nano_defconfig
```kconfig
# SPDX-License-Identifier: Apache-2.0

CONFIG_ARM_MPU=y
CONFIG_PINCTRL=y
CONFIG_GPIO=y
CONFIG_USE_DT_CODE_PARTITION=y
CONFIG_BUILD_OUTPUT_UF2=y
CONFIG_FLASH=y
CONFIG_FLASH_PAGE_LAYOUT=y
CONFIG_FLASH_MAP=y
```

## boards/shields/kerfur_oled/Kconfig.defconfig
```kconfig
# SPDX-License-Identifier: Apache-2.0

if SHIELD_KERFUR_OLED

if DISPLAY

if LVGL

config LV_Z_VDB_SIZE
	default 64

config LV_DPI_DEF
	default 148

config LV_Z_COLOR_MONO_HW_INVERSION
	default y

choice LV_COLOR_DEPTH
	default LV_COLOR_DEPTH_1
endchoice

endif # LVGL

endif # DISPLAY

endif # SHIELD_KERFUR_OLED
```

## boards/shields/kerfur_oled/Kconfig.shield
```kconfig
# SPDX-License-Identifier: Apache-2.0

config SHIELD_KERFUR_OLED
	def_bool $(shields_list_contains,kerfur_oled)
```
